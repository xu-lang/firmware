## general/package/gpio-key/Config.in
```kconfig
config BR2_PACKAGE_GPIO_KEY
	bool "gpio-key"
	help
	  Monitor a sysfs GPIO input and report click, double-click, and
	  hold events.

	  Installs /etc/gpio-key.conf and /etc/init.d/S99gpio-key. The
	  service is disabled by default until enabled=1 is set in the
	  configuration file.

	  https://openipc.org
```

## general/package/sigmastar-venc-poc/Config.in
```kconfig
config BR2_PACKAGE_SIGMASTAR_VENC_POC
	bool "sigmastar-venc-poc"
	default n
	help
	  Experimental Sigmastar MI VENC proof-of-concept tools.
	  Disabled by default; enable only for manual VENC experiments.

	  The package builds a standalone tool that loads Sigmastar MI libraries
	  at runtime with dlopen(). It includes VENC lifecycle probes, synthetic
	  NV12-to-VENC tests, and a camera-to-NV12 raw dump mode.

	  The included MI ABI header is reverse engineered and must be treated
	  as experimental until verified against an official Sigmastar SDK.
```
